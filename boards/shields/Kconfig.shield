## boards/shields/Kconfig.shield
```kconfig
# Copyright (c) 2020 Pete Johanson
# SPDX-License-Identifier: MIT

config SHIELD_VIREAL_CORNE_LEFT
    def_bool $(shields_list_contains,vireal_corne_left)

config SHIELD_VIREAL_CORNE_RIGHT
    def_bool $(shields_list_contains,vireal_corne_right)
```
